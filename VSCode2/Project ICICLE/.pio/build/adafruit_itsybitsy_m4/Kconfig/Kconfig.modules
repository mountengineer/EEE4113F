## VSCode2/Project ICICLE/.pio/build/adafruit_itsybitsy_m4/Kconfig/Kconfig.modules
```kconfig
menu "CANopenNode (C:\Users\Justin\.platformio\packages\framework-zephyr\_pio\modules\lib\canopennode)"
osource "$(ZEPHYR_CANOPENNODE_KCONFIG)"
config ZEPHYR_CANOPENNODE_MODULE
	bool
	default y
endmenu
menu "loramac-node (C:\Users\Justin\.platformio\packages\framework-zephyr\_pio\modules\lib\loramac-node)"
osource "$(ZEPHYR_LORAMAC_NODE_KCONFIG)"
config ZEPHYR_LORAMAC_NODE_MODULE
	bool
	default y
endmenu
menu "lz4 (C:\Users\Justin\.platformio\packages\framework-zephyr\_pio\modules\lib\lz4)"
osource "$(ZEPHYR_LZ4_KCONFIG)"
config ZEPHYR_LZ4_MODULE
	bool
	default y
endmenu
menu "mbedtls (C:\Users\Justin\.platformio\packages\framework-zephyr\_pio\modules\crypto\mbedtls)"
osource "$(ZEPHYR_MBEDTLS_KCONFIG)"
config ZEPHYR_MBEDTLS_MODULE
	bool
	default y
endmenu
menu "nanopb (C:\Users\Justin\.platformio\packages\framework-zephyr\_pio\modules\lib\nanopb)"
osource "$(ZEPHYR_NANOPB_KCONFIG)"
config ZEPHYR_NANOPB_MODULE
	bool
	default y
endmenu
menu "sof (C:\Users\Justin\.platformio\packages\framework-zephyr\_pio\modules\audio\sof)"
osource "C:/Users/Justin/.platformio/packages/framework-zephyr/_pio/modules/audio/sof/zephyr/Kconfig"
config ZEPHYR_SOF_MODULE
	bool
	default y
endmenu
menu "tflite-micro (C:\Users\Justin\.platformio\packages\framework-zephyr\_pio\modules\lib\tflite-micro)"
osource "$(ZEPHYR_TFLITE_MICRO_KCONFIG)"
config ZEPHYR_TFLITE_MICRO_MODULE
	bool
	default y
endmenu
menu "TraceRecorder (C:\Users\Justin\.platformio\packages\framework-zephyr\_pio\modules\debug\TraceRecorder)"
osource "C:/Users/Justin/.platformio/packages/framework-zephyr/_pio/modules/debug/TraceRecorder/kernelports/Zephyr/Kconfig"
config ZEPHYR_TRACERECORDER_MODULE
	bool
	default y
endmenu
```
